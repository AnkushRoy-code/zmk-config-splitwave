## boards/shields/splitwave/Kconfig.defconfig
```kconfig
if SHIELD_SPLITWAVE_LEFT

# Name must be less than 16 characters long!
config ZMK_KEYBOARD_NAME
    default "SplitWave"

config ZMK_SPLIT_ROLE_CENTRAL
    default y

config ZMK_USB
    default y

endif

if SHIELD_SPLITWAVE_LEFT || SHIELD_SPLITWAVE_RIGHT

config ZMK_SPLIT
    default y

endif
```

## boards/shields/splitwave/Kconfig.shield
```kconfig
# No whitespace after the comma or in your part name!
config SHIELD_SPLITWAVE_LEFT
    def_bool $(shields_list_contains,splitwave_left)

# No whitespace after the comma or in your part name!
config SHIELD_SPLITWAVE_RIGHT
    def_bool $(shields_list_contains,splitwave_right)
```
